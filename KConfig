## KConfig
```kconfig
# https://doc.coreboot.org/getting_started/kconfig.html?highlight=kconfig
# https://github.com/jgunthorpe/busybox/blob/master/scripts/config/Kconfig-language.txt
# Busybox use an interesting way for his "applet", they self-contained the Kconfig that is extracted
# at build time by scripts/gen_build_files.sh, see busybox/docs/new-applet-HOWTO.txt

mainmenu "lwNBD Configuration"

menu "Settings"

comment 'Debugging Options'

config LOG
    bool "Build with log"
    default n
    help
    Say Y here to compile with

config LOG_DEFAULT_LEVEL
    int "Default log level"
    range 0 4
    default 3
    depends on LOG
    help
      Sets log level for modules which don't specify it explicitly. When
      set to 0 it means log will not be activated for those modules.
      Levels are:
      
      - 0 OFF
      - 1 ERROR,
      - 2 WARNING
      - 3 INFO
      - 4 DEBUG
    
config DEBUG
    bool "Build with debug information"
    default n
    depends on !IOP && !EE
    help
    Say Y here to compile with debug information.
    This increases the size of the binary considerably, and
    should only be used when doing development.

    This adds -g option to gcc command line.

    Most people should answer N.

config CROSS_COMPILER_PREFIX
    string "Cross compiler prefix"
    default ""
    help
    If you want to build lwNBD with a cross compiler, then you
    will need to set this to the cross-compiler prefix, for example,
    "i386-uclibc-".

    Note that CROSS_COMPILE environment variable or
    "make CROSS_COMPILE=xxx ..." will override this selection.

    Native builds leave this empty.

endmenu

source ports/Kconfig
source servers/Kconfig
source src/Kconfig
source plugins/Kconfig
source examples/Kconfig
```

## examples/Kconfig
```kconfig
menu "Examples"

config BUILD_EXAMPLES
        bool "Build examples" 
        default y

config LOCAL_READER
        bool "local reader" 
        default y
        depends on BUILD_EXAMPLES && UNIX

config LOCAL_SHELL
        bool "local shell"
        default y
        depends on BUILD_EXAMPLES && UNIX && BUILTIN_COMMAND

config LOCAL_COMMAND_WC
        bool "local command wc"
        default y
        depends on BUILD_EXAMPLES && UNIX

config SDL_TEXT
        bool "sdl text"
        default y
        depends on BUILD_EXAMPLES && EE

config LWNBD_SERVER
        bool "lwnbd-server"
        default y
        depends on BUILD_EXAMPLES && URI && UNIX && NBD_SERVER
        
config DAYTIMED
        bool "daytimed"
        default y
        depends on BUILD_EXAMPLES && URI && UNIX && DAYTIME_SERVER

config MINI_XINETD
        bool "mini-xinetd"
        default y
        depends on BUILD_EXAMPLES && UNIX
        
endmenu
```

## plugins/Kconfig
```kconfig
menu "Plugins"

config PLUGIN_ATAD
        bool "Support Playstation 2 HDD"
        default y
        depends on IOP

menu "Support query"
source plugins/command/Kconfig
endmenu

config PLUGIN_FILE
        bool "Support file"
        default y
        depends on (UNIX || EE)

config PLUGIN_MCMAN
        bool "Support Playstation 2 Memory Cards"
        default y
        depends on IOP

config PLUGIN_MEMORY
        bool "Support Memory"
        default y

config PLUGIN_PCMSTREAM
        bool "Support PCM stream on Playstation 2"
        default n
        depends on IOP

config PLUGIN_TTY
        bool "Support Playstation 2 tty"
        default n
        depends on IOP

endmenu
```

## plugins/command/Kconfig
```kconfig
config PLUGIN_COMMAND
        bool "Support query" 
        default n
        depends on URI
 
config BUILTIN_COMMAND
        bool "Build builtins commands"
        default y
        depends on PLUGIN_COMMAND
        
#config BUILTIN_ECHO
#        bool "echo builtin"
#        default y
#        depends on BUILTIN_COMMAND
```

## ports/Kconfig
```kconfig
comment 'Target Options'

choice
        prompt "Target Architecture"
        default UNIX

config EE
    bool "Playstation 2 Emotion Engine"
    select NET
    select USB
    select SERIAL

config IOP
    bool "Playstation 2 IOP"
    select NET
    select USB
    select SERIAL

config UNIX
    bool "unix"
    select NET
    select USB
    select SERIAL

endchoice

config NET
    bool
    default n

config USB
    bool
    default n

config SERIAL
    bool
    default n
```

## servers/Kconfig
```kconfig
menu "Servers"

config CHARGEN_SERVER
        bool "Support CHARGEN transport"
        default y
        depends on NET

config DAYTIME_SERVER
        bool "Support DAYTIME transport"
        default y
        depends on NET

menu "NBD"
source "servers/nbd/Kconfig"
endmenu

config SIF_SERVER
        bool "Support SIF transport"
        default y
        depends on IOP
        
config SSDP_SERVER
        bool "Support SSDP transport"
        default y
        depends on NET        

endmenu
```

## servers/nbd/Kconfig
```kconfig
config NBD_SERVER
        bool "Support NBD transport"
        default y

config MAX_RETRIES
        int "Maximum retry"
        range 0 100
        default 5
        depends on NBD_SERVER

config NBD_BUFFER_LEN
        int "Buffer size"
        range 0 4096
        default 4096
        depends on NBD_SERVER
```
